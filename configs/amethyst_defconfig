## configs/amethyst_defconfig
```kconfig
CONFIG_XNU_BUILD_ARCHIVES=y
CONFIG_XNU_SOURCE_CORECRYPTO14=y
CONFIG_XNU_CRYPTO_BOOTSTRAP="prelinked"
CONFIG_XNU_ARM_DT_PLATFORM=y
CONFIG_XNU_ARMCPU=y
CONFIG_XNU_SOURCE_PTHREAD=y
CONFIG_XNU_NATIVE_UFS=y
CONFIG_XNU_NATIVE_AES=y
CONFIG_XNU_NATIVE_RAM_BLOCK=y
CONFIG_XNU_SOURCE_MOCKFS=y
CONFIG_XNU_OWNER_DATA_VOLUME_UUID="00000000-0000-0000-0000-000000000000"
CONFIG_XNU_WATCHDOG_POLICY=y
CONFIG_XNU_NATIVE_LEGACY_DISPLAY=n
CONFIG_XNU_NATIVE_ARCH_TIMER=y
CONFIG_XNU_NATIVE_PAN=y
CONFIG_XNU_TRUST_CACHE_RUNTIME=y
CONFIG_XNU_NATIVE_CS_HASH_CACHE=y
CONFIG_XNU_NATIVE_MOBILE_DISPLAY=n
CONFIG_XNU_ARMVIRT_PLATFORM=n
CONFIG_XNU_EXTRA_LD_ARCHIVES=""

# CONFIG_XNU_ZONE_PGZ_ALIGNMENT_PROBE is not set
# CONFIG_XNU_NATIVE_VIRTIO_BLOCK is not set
# CONFIG_XNU_VERIFIED_ROOT_PROBE is not set
# CONFIG_XNU_OWNER_ROOT_AUDIT is not set
# CONFIG_XNU_OWNER_ROOT_TRUST is not set
# CONFIG_XNU_OWNER_BOOT_MANIFEST is not set
# CONFIG_XNU_BOOT_PROGRESS is not set
# CONFIG_XNU_NATIVE_ADRENO is not set
```
